## boards/CopyRenameBoard/Kconfig.copyrenameboard
```kconfig
# Copyright (c) 2025 Mathieu Anquetin <mathieu.anquetin@groupe-cahors.com>
# SPDX-License-Identifier: Apache-2.0

config BOARD_COPYRENAMEBOARD
	select SOC_STM32F439XX
```

## boards/CopyRenameBoard/Kconfig.defconfig
```kconfig
# NUCLEO-144 F439ZI based board configuration

# Copyright (c) 2025 Mathieu Anquetin <mathieu.anquetin@groupe-cahors.com>
# SPDX-License-Identifier: Apache-2.0

if BOARD_COPYRENAMEBOARD

if NETWORKING

config NET_L2_ETHERNET
	default y

endif # NETWORKING

endif # BOARD_COPYRENAME
```

## boards/CopyRenameBoard/board.yml
```yaml
board:
  name: copyrenameboard
  full_name: Nucleo F439ZI / copyrenameboard
  vendor: st
  socs:
    - name: stm32f439xx
```

## boards/FromScratch/board.yml
```yaml
board:
  name: fromscratch
  full_name: My STM32F439ZI Board From Scratch
  vendor: others
  socs:
    - name: stm32f439xx
```

## led-sensor-module/Kconfig
```kconfig
menu "Custom LED sensor module"
    rsource "drivers/led_sensor/Kconfig"
endmenu
```

## led-sensor-module/drivers/led_sensor/Kconfig
```kconfig
config LED_SENSOR
    bool "On-board LED exposed via Sensor API"
    default y
    depends on DT_HAS_CUSTOM_LED_SENSOR_ENABLED
    depends on GPIO && SENSOR
    help
      The LED is switched ON when sensor_sample_fetch() is called and switched OFF when sensor_channel_get() is called.
```

## led-sensor-module/dts/bindings/sensor/custom,led-sensor.yaml
```yaml
description: On-board LED controlled using the Zephyr Sensor API
compatible: "custom,led-sensor"
properties:
  led:
    type: phandle
    required: true
    description: Phandle to a GPIO LED node containing the gpios property
```
